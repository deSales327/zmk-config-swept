## config/boards/shields/swept/Kconfig.defconfig
```kconfig
# Copyright (c) 2020 The ZMK Contributors
# SPDX-License-Identifier: MIT

if SHIELD_TPS65_TRACKPAD

config ZMK_KEYBOARD_NAME
	default "TPS65 Trackpad" 

config I2C
	default y
      
config ZMK_POINTING
	default y

endif
```

## config/boards/shields/swept/Kconfig.shield
```kconfig
# Copyright (c) 2020 The ZMK Contributors
# SPDX-License-Identifier: MIT

config SHIELD_TPS65_TRACKPAD
	def_bool $(shields_list_contains,tps65_trackpad)
```
